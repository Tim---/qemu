## hw/zen/Kconfig
```kconfig
config FCH
    bool
    select SSI
    select SSI_M25P80

config ZEN
    bool
    select CCP
    select UNIMP
    select FCH
    select ISA_BUS
    select SMBUS
    select ACPI

config CCP
    bool

config PSP_DEVS
    bool
```
